## firmware/esp32-telemetry/sdkconfig.defaults
```kconfig
CONFIG_MQTT_PROTOCOL_311=y
CONFIG_MQTT_TRANSPORT_SSL=y
CONFIG_MQTT_USE_CUSTOM_CONFIG=y
CONFIG_MQTT_OUTBOX_EXPIRED_TIMEOUT_MS=60000
CONFIG_MQTT_REPORT_DELETED_MESSAGES=y
CONFIG_LWIP_SNTP_UPDATE_DELAY=3600000
CONFIG_LOG_DEFAULT_LEVEL_INFO=y
CONFIG_MBEDTLS_HAVE_TIME_DATE=y
CONFIG_ESPTOOLPY_FLASHSIZE_4MB=y
```
